## kernel-3a2a205/drivers/input/sensors/Kconfig
```kconfig
#
# Sensor driver configuration
#

config SENSORS_AL3320A
        bool "AL3320A Light Sensor"
        depends on I2C

config SENSORS_AKM8963
	tristate "AK8963 compass support"
	default n
	depends on I2C
	help
	  If you say yes here you get support for Asahi Kasei's
	  orientation sensor AK8963.

config SENSORS_AL3320_EC
        bool "AL3320A Light Sensor at EC base on TX201LA"
        depends on I2C


config HALL_SENSOR 
       bool "Hall sensor" 
       default n
```

## kernel-3a2a205/drivers/input/switch/Kconfig
```kconfig
#
# switch button driver configuration
#

# Joe add for switch button driver ++

config SWITCH_BUTTON
	tristate "switch button support"
	depends on GENERIC_GPIO
	help
	  Say y here if you have an switch button.

# Joe add for switch button driver --
```

## kernel-3a2a205/drivers/power/ME302C_BATTERY/Kconfig
```kconfig
#
#  Copyright (c) 2012, ASUSTek, Inc. All Rights Reserved.
#  Written by chris chang chris1_chang@asus.com
#
#  Battery driver configuration
#
menuconfig ME302C_BATTERY
	bool "ME302C Battery support"
	help
	  Say Y here. This option doesn't affect the kernel.
	  If unsure, say Y.

menuconfig ASUS_ENGINEER_MODE
	bool "ME570KL Battery Engineer Mode"
	help
	  Say Y here. This option doesn't affect the kernel.
	  If unsure, say Y.

if ME302C_BATTERY

config ME302C_BATTERY_SMB347
	tristate "SMB347 battery charger driver"
	depends on I2C
	help
	  Say Y to enable support for the SMB347 switching mode based charger
	  and sysfs. The driver supports controlling charger-enable and
	  current limiting capabilities. The driver also lets the
	  SMB347 be operated as a slave device via the power supply
	  framework.

config ME302C_BATTERY_BQ27520
	tristate "ASUS BQ27520 battery driver"
	depends on I2C
	help
	  Say Y here to enable support for batteries with BQ27520(I2C) chips.

endif
```
